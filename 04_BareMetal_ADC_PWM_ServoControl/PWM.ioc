# file: PWM.ioc
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FREERTOS.Tasks01=Lectura_Task,24,128,StartDefaultTask,Default,NULL,Dynamic,NULL,NULL;Servo_Task,8,128,StartTask02,Default,NULL,Dynamic,NULL,NULL
Mcu.Family=STM32F4
Mcu.Name=STM32F446R(C-E)Tx
Mcu.Package=LQFP64
NVIC.PriorityGroup=NVIC_PRIORITYGROUP_4
NVIC.TIM6_DAC_IRQn=true\:15\:0\:false\:false\:true\:false\:false\:true\:true
NVIC.TimeBase=TIM6_DAC_IRQn
NVIC.TimeBaseIP=TIM6
PA13.Mode=Trace_Asynchronous_SW
PA13.Signal=SYS_JTMS-SWDIO
PA14.Mode=Trace_Asynchronous_SW
PA14.Signal=SYS_JTCK-SWCLK
PB3.Mode=Trace_Asynchronous_SW
PB3.Signal=SYS_JTDO-SWO
ProjectManager.HeapSize=0x200
ProjectManager.StackSize=0x400
ProjectManager.TargetToolchain=STM32CubeIDE
RCC.48MHZClocksFreq_Value=84000000
RCC.AHBFreq_Value=84000000
RCC.APB1CLKDivider=RCC_HCLK_DIV2
RCC.APB1Freq_Value=42000000
RCC.APB1TimFreq_Value=84000000
RCC.APB2Freq_Value=84000000
RCC.APB2TimFreq_Value=84000000
RCC.CortexFreq_Value=84000000
RCC.FLatency-AdvancedSettings=FLASH_LATENCY_2
RCC.HCLKFreq_Value=84000000
RCC.HSE_VALUE=8000000
RCC.HSI_VALUE=16000000
RCC.PLLN=336
RCC.PLLP=RCC_PLLP_DIV4
RCC.SYSCLKFreq_VALUE=84000000
RCC.SYSCLKSource=RCC_SYSCLKSOURCE_PLLCLK
RCC.USBFreq_Value=168000000
RCC.VCOOutputFreq_Value=336000000
VP_FREERTOS_VS_CMSIS_V2.Mode=CMSIS_V2
VP_SYS_VS_tim6.Mode=TIM6
board=NUCLEO-F446RE

// file: Core/Src/main.c
/* USER CODE BEGIN Header */
/**
  ******************************************************************************
  * @file           : main.c
  * @brief          : Main program body
  ******************************************************************************
  * @attention
  *
  * Copyright (c) 2026 STMicroelectronics.
  * All rights reserved.
  *
  * This software is licensed under terms that can be found in the LICENSE file
  * in the root directory of this software component.
  * If no LICENSE file comes with this software, it is provided AS-IS.
  *
  ******************************************************************************
  */
/* USER CODE END Header */
#include "main.h"
#include "cmsis_os.h"

/* USER CODE BEGIN PTD */

// ====================================================================================================
// 1. DIRECCIONES BASE DE LOS PERIFÉRICOS (Mapeo de Memoria Absoluto del Sistema - Reference Manual)
// ====================================================================================================
#define RCC_BASE      0x40023800  // Base del Bloque Reset and Clock Control (Bus AHB1)
#define GPIOA_BASE    0x40020000  // Base del Puerto GPIOA (Bus AHB1)
#define TIM3_BASE     0x40000400  // Base del Temporizador TIM3 (Bus APB1)
#define ADC1_BASE     0x40012000  // Base del Convertidor ADC1 (Bus APB2)

// ====================================================================================================
// 2. REGISTROS ESPECÍFICOS USANDO LAS BASES + OFFSETS
// ====================================================================================================

// --- REGISTROS DEL RCC ---
#define REG_RCC_AHB1ENR   (*(volatile uint32_t*)(RCC_BASE + 0x30))
#define REG_RCC_APB1ENR   (*(volatile uint32_t*)(RCC_BASE + 0x40))
#define REG_RCC_APB2ENR   (*(volatile uint32_t*)(RCC_BASE + 0x44))

// --- REGISTROS DEL PUERTO GPIOA ---
#define REG_GPIOA_MODER   (*(volatile uint32_t*)(GPIOA_BASE + 0x00))
#define REG_GPIOA_AFRL    (*(volatile uint32_t*)(GPIOA_BASE + 0x20))

// --- REGISTROS DEL TIMER 3 (PWM del Servo) ---
#define REG_TIM3_CR1      (*(volatile uint32_t*)(TIM3_BASE + 0x00))
#define REG_TIM3_EGR      (*(volatile uint32_t*)(TIM3_BASE + 0x14)) // Registro EGR para forzar actualización
#define REG_TIM3_CCMR1    (*(volatile uint32_t*)(TIM3_BASE + 0x18))
#define REG_TIM3_CCER     (*(volatile uint32_t*)(TIM3_BASE + 0x20))
#define REG_TIM3_PSC      (*(volatile uint32_t*)(TIM3_BASE + 0x28))
#define REG_TIM3_ARR      (*(volatile uint32_t*)(TIM3_BASE + 0x2C))
#define REG_TIM3_CCR1     (*(volatile uint32_t*)(TIM3_BASE + 0x34))

// --- REGISTROS DEL ADC1 (Muestreo del Potenciómetro) ---
#define REG_ADC1_SR       (*(volatile uint32_t*)(ADC1_BASE + 0x00))
#define REG_ADC1_CR1      (*(volatile uint32_t*)(ADC1_BASE + 0x04))
#define REG_ADC1_CR2      (*(volatile uint32_t*)(ADC1_BASE + 0x08))
#define REG_ADC1_SQR3     (*(volatile uint32_t*)(ADC1_BASE + 0x34))
#define REG_ADC1_DR       (*(volatile uint32_t*)(ADC1_BASE + 0x4C))

/* USER CODE END PTD */

/* Definitions for Lectura_Task */
osThreadId_t Lectura_TaskHandle;
const osThreadAttr_t Lectura_Task_attributes = {
  .name = "Lectura_Task",
  .stack_size = 128 * 4,
  .priority = (osPriority_t) osPriorityNormal,
};
/* Definitions for Servo_Task */
osThreadId_t Servo_TaskHandle;
const osThreadAttr_t Servo_Task_attributes = {
  .name = "Servo_Task",
  .stack_size = 128 * 4,
  .priority = (osPriority_t) osPriorityLow,
};

void SystemClock_Config(void);
static void MX_GPIO_Init(void);
void StartDefaultTask(void *argument);
void StartTask02(void *argument);

/* USER CODE BEGIN 0 */

// Variable global volátil compartida entre la tarea de lectura y la tarea del servo
volatile uint16_t adc_valor_pot = 0;

// Función de inicialización manual de hardware a nivel de registros puros
void MCU_Hardware_Init(void) {
    // ------------------------------------------------------------------------------------------------
    // PASO 1: ENERGIZAR PERIFÉRICOS Y ESTABILIZAR RELOJ
    // ------------------------------------------------------------------------------------------------
    REG_RCC_AHB1ENR |= (1 << 0);    // Despierta GPIOA
    REG_RCC_APB1ENR |= (1 << 1);    // Despierta Timer 3
    REG_RCC_APB2ENR |= (1 << 8);    // Despierta ADC1

    // Bus synchronization delay (dummy read)
    volatile uint32_t delay_calculo;
    delay_calculo = REG_RCC_APB1ENR;
    delay_calculo = REG_RCC_APB2ENR;
    (void)delay_calculo; // Evita warning del compilador por variable no usada

    // ------------------------------------------------------------------------------------------------
    // PASO 2: CONFIGURACIÓN ELÉCTRICA DE PINES (Módulo GPIOA)
    // ------------------------------------------------------------------------------------------------
    REG_GPIOA_MODER &= ~((3 << (0 * 2)) | (3 << (6 * 2))); // Limpiar bits de PA0 y PA6

    REG_GPIOA_MODER |= (3 << (0 * 2));                    // PA0 Analógico (11)
    REG_GPIOA_MODER |= (2 << (6 * 2));                    // PA6 Función Alterna (10)

    REG_GPIOA_AFRL  &= ~(0xF << (6 * 4));                 // Limpiar multiplexor del pin 6
    REG_GPIOA_AFRL  |=  (2   << (6 * 4));                 // AF2 (TIM3_CH1)

    // ------------------------------------------------------------------------------------------------
    // PASO 3: CONFIGURACIÓN DEL TIMER 3 (PWM a 50Hz) - ¡CORREGIDO PARA RELOJ DE 84 MHz!
    // ------------------------------------------------------------------------------------------------
    // Como SystemClock_Config aceleró el reloj a 84 MHz, dividimos entre 84 (escribiendo 83)
    REG_TIM3_PSC   = 83;                  // Prescaler: 84 MHz / 84 = 1 MHz. (1 cuenta = 1 us)
    REG_TIM3_ARR   = 19999;               // ARR: 20,000 us = 20 ms de periodo (50 Hz)

    REG_TIM3_CCMR1 &= ~(0x3 << 0);        // Forzar Canal 1 como Salida (CC1S = 00)
    REG_TIM3_CCMR1 &= ~(0x7 << 4);        // Limpiar modo OC1M
    REG_TIM3_CCMR1 |= (6 << 4) | (1 << 3); // Modo PWM 1 (110) + Preload activo

    REG_TIM3_CCER  &= ~(1 << 1);          // Polaridad activa en alto
    REG_TIM3_CCER  |= (1 << 0);           // Habilitar salida en PA6

    REG_TIM3_CCR1  = 1500;                // Posición inicial: Centro (1.5 ms)

    REG_TIM3_EGR   |= (1 << 0);           // Generar evento Update de inmediato
    REG_TIM3_CR1   |= (1 << 0);           // Arrancar el temporizador

    // ------------------------------------------------------------------------------------------------
    // PASO 4: CONFIGURACIÓN DEL CONVERTIDOR ANALÓGICO (ADC1)
    // ------------------------------------------------------------------------------------------------
    REG_ADC1_CR1   &= ~(3 << 24);         // Forzar resolución de 12 bits
    REG_ADC1_SQR3  &= ~(0x1F);            // Leer primero el Canal 0 (PA0)

    REG_ADC1_CR2   |= (1 << 0);           // Energizar el ADC
}
/* USER CODE END 0 */

int main(void)
{

  /* MCU Configuration--------------------------------------------------------*/

  /* Reset of all peripherals, Initializes the Flash interface and the Systick. */
  HAL_Init();

  /* Configure the system clock */
  SystemClock_Config();

  /* Initialize all configured peripherals */
  MX_GPIO_Init();

  /* USER CODE BEGIN 2 */
  // Disparo manual y seguro de nuestro hardware de bajo nivel
  MCU_Hardware_Init();
  /* USER CODE END 2 */

  /* Init scheduler */
  osKernelInitialize();

  /* Create the thread(s) */
  /* creation of Lectura_Task */
  Lectura_TaskHandle = osThreadNew(StartDefaultTask, NULL, &Lectura_Task_attributes);

  /* creation of Servo_Task */
  Servo_TaskHandle = osThreadNew(StartTask02, NULL, &Servo_Task_attributes);

  /* Start scheduler */
  osKernelStart();

  /* We should never get here as control is now taken by the scheduler */

  /* Infinite loop */
  while (1)
  {

  }
}

void SystemClock_Config(void)
{
  RCC_OscInitTypeDef RCC_OscInitStruct = {0};
  RCC_ClkInitTypeDef RCC_ClkInitStruct = {0};

  /** Configure the main internal regulator output voltage
  */
  __HAL_RCC_PWR_CLK_ENABLE();
  __HAL_PWR_VOLTAGESCALING_CONFIG(PWR_REGULATOR_VOLTAGE_SCALE3);

  /** Initializes the RCC Oscillators according to the specified parameters
  * in the RCC_OscInitTypeDef structure.
  */
  RCC_OscInitStruct.OscillatorType = RCC_OSCILLATORTYPE_HSI;
  RCC_OscInitStruct.HSIState = RCC_HSI_ON;
  RCC_OscInitStruct.HSICalibrationValue = RCC_HSICALIBRATION_DEFAULT;
  RCC_OscInitStruct.PLL.PLLState = RCC_PLL_ON;
  RCC_OscInitStruct.PLL.PLLSource = RCC_PLLSOURCE_HSI;
  RCC_OscInitStruct.PLL.PLLM = 16;
  RCC_OscInitStruct.PLL.PLLN = 336;
  RCC_OscInitStruct.PLL.PLLP = RCC_PLLP_DIV4;
  RCC_OscInitStruct.PLL.PLLQ = 2;
  RCC_OscInitStruct.PLL.PLLR = 2;
  if (HAL_RCC_OscConfig(&RCC_OscInitStruct) != HAL_OK)
  {
    Error_Handler();
  }

  /** Initializes the CPU, AHB and APB buses clocks
  */
  RCC_ClkInitStruct.ClockType = RCC_CLOCKTYPE_HCLK|RCC_CLOCKTYPE_SYSCLK
                              |RCC_CLOCKTYPE_PCLK1|RCC_CLOCKTYPE_PCLK2;
  RCC_ClkInitStruct.SYSCLKSource = RCC_SYSCLKSOURCE_PLLCLK;
  RCC_ClkInitStruct.AHBCLKDivider = RCC_SYSCLK_DIV1;
  RCC_ClkInitStruct.APB1CLKDivider = RCC_HCLK_DIV2;
  RCC_ClkInitStruct.APB2CLKDivider = RCC_HCLK_DIV1;

  if (HAL_RCC_ClockConfig(&RCC_ClkInitStruct, FLASH_LATENCY_2) != HAL_OK)
  {
    Error_Handler();
  }
}

static void MX_GPIO_Init(void)
{

  /* GPIO Ports Clock Enable */
  __HAL_RCC_GPIOA_CLK_ENABLE();
  __HAL_RCC_GPIOB_CLK_ENABLE();

}

void StartDefaultTask(void *argument)
{
  /* USER CODE BEGIN 5 */
  /* Infinite loop */
  for(;;)
  {
    REG_ADC1_CR2 |= (1 << 30); // Lanzar conversión

    // Esperar a que la bandera EOC se levante
    while (!(REG_ADC1_SR & (1 << 1)));

    // Guardar el valor puro de 12 bits
    adc_valor_pot = REG_ADC1_DR;

    // Ceder el control al RTOS
    osDelay(20);
  }
  /* USER CODE END 5 */
}

void StartTask02(void *argument)
{
  /* USER CODE BEGIN StartTask02 */
  uint32_t ccr_calculado = 1500;

  /* Infinite loop */
  for(;;)
  {
      // Matemática para mapear de forma lineal los 12 bits del ADC a un Duty Cycle de 1000 a 2000
      ccr_calculado = 1000 + ((uint32_t)adc_valor_pot * 1000) / 4095;

      // Inyectar al registro del Timer
      REG_TIM3_CCR1 = ccr_calculado;

      // Ceder el procesador
      osDelay(30);
  }
  /* USER CODE END StartTask02 */
}

void HAL_TIM_PeriodElapsedCallback(TIM_HandleTypeDef *htim)
{
  if (htim->Instance == TIM6) {
    HAL_IncTick();
  }
}

void Error_Handler(void)
{
  __disable_irq();
  while (1)
  {
  }
}
