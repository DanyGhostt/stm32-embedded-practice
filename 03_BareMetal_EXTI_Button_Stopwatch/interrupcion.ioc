# file: interrupcion.ioc
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FREERTOS.Mutexes01=myMutex01,Dynamic,NULL,Available
FREERTOS.Tasks01=defaultTask,24,128,StartDefaultTask,Default,NULL,Dynamic,NULL,NULL;myTask02,8,128,StartTask02,Default,NULL,Dynamic,NULL,NULL;myTask03,8,128,StartTask03,Default,NULL,Dynamic,NULL,NULL
Mcu.Family=STM32F4
Mcu.Name=STM32F446R(C-E)Tx
Mcu.Package=LQFP64
NVIC.PriorityGroup=NVIC_PRIORITYGROUP_4
NVIC.TIM4_IRQn=true\:15\:0\:false\:false\:true\:false\:false\:true\:true
NVIC.TimeBase=TIM4_IRQn
NVIC.TimeBaseIP=TIM4
PA13.Mode=Trace_Asynchronous_SW
PA13.Signal=SYS_JTMS-SWDIO
PA14.Mode=Trace_Asynchronous_SW
PA14.Signal=SYS_JTCK-SWCLK
PB3.Mode=Trace_Asynchronous_SW
PB3.Signal=SYS_JTDO-SWO
ProjectManager.HeapSize=0x200
ProjectManager.StackSize=0x400
ProjectManager.TargetToolchain=STM32CubeIDE
RCC.48MHZClocksFreq_Value=84000000
RCC.AHBFreq_Value=84000000
RCC.APB1CLKDivider=RCC_HCLK_DIV2
RCC.APB1Freq_Value=42000000
RCC.APB1TimFreq_Value=84000000
RCC.APB2Freq_Value=84000000
RCC.APB2TimFreq_Value=84000000
RCC.CortexFreq_Value=84000000
RCC.FLatency-AdvancedSettings=FLASH_LATENCY_2
RCC.HCLKFreq_Value=84000000
RCC.HSE_VALUE=8000000
RCC.HSI_VALUE=16000000
RCC.PLLN=336
RCC.PLLP=RCC_PLLP_DIV4
RCC.SYSCLKFreq_VALUE=84000000
RCC.SYSCLKSource=RCC_SYSCLKSOURCE_PLLCLK
RCC.USBFreq_Value=168000000
RCC.VCOOutputFreq_Value=336000000
VP_FREERTOS_VS_CMSIS_V2.Mode=CMSIS_V2
VP_SYS_VS_tim4.Mode=TIM4
board=NUCLEO-F446RE

// file: Core/Src/main.c
/* USER CODE BEGIN Header */
/**
  ******************************************************************************
  * @file           : main.c
  * @brief          : Main program body
  ******************************************************************************
  * @attention
  *
  * Copyright (c) 2026 STMicroelectronics.
  * All rights reserved.
  *
  * This software is licensed under terms that can be found in the LICENSE file
  * in the root directory of this software component.
  * If no LICENSE file comes with this software, it is provided AS-IS.
  *
  ******************************************************************************
  */
/* USER CODE END Header */
#include "main.h"
#include "cmsis_os.h"

/* USER CODE BEGIN PD */
#define RCC_BASE_M        0x40023800UL  // Reset and Clock Control
#define GPIOA_BASE_M      0x40020000UL  // Puerto A: Base para LEDs y Testigo
#define GPIOC_BASE_M      0x40020800UL  // Puerto C: Botón de usuario PC13
#define SYSCFG_BASE_M     0x40013800UL  // System Configuration (Multiplexor EXTI)
#define EXTI_BASE_M       0x40013C00UL  // External Interrupt Controller
#define TIM4_BASE_M       0x40000800UL  // Timer 4: Telemetría de microsegundos
#define NVIC_BASE_M       0xE000E100UL  // Controlador de Interrupciones de la CPU

#define RCC_AHB1ENR_M     (*(volatile uint32_t *)(RCC_BASE_M + 0x30)) // Reloj GPIO
#define RCC_APB1ENR_M     (*(volatile uint32_t *)(RCC_BASE_M + 0x40)) // Reloj TIM4
#define RCC_APB2ENR_M     (*(volatile uint32_t *)(RCC_BASE_M + 0x44)) // Reloj SYSCFG

// --- REGISTROS DE GPIOA (LEDs y Testigo) ---
#define GPIOA_MODER_M     (*(volatile uint32_t *)(GPIOA_BASE_M + 0x00)) // Modo de pines
#define GPIOA_ODR_M       (*(volatile uint32_t *)(GPIOA_BASE_M + 0x14)) // Datos de Salida

// --- REGISTROS DE GPIOC (Botón) ---
#define GPIOC_MODER_M     (*(volatile uint32_t *)(GPIOC_BASE_M + 0x00)) // Modo de Puerto C
#define GPIOC_IDR_M       (*(volatile uint32_t *)(GPIOC_BASE_M + 0x10)) // Datos de Entrada

// --- REGISTROS DE INTERRUPCIÓN (SYSCFG + EXTI) ---
#define SYSCFG_EXTICR4_M  (*(volatile uint32_t *)(SYSCFG_BASE_M + 0x14)) // Enrutador EXTI13
#define EXTI_IMR_M        (*(volatile uint32_t *)(EXTI_BASE_M + 0x00)) // Máscara
#define EXTI_FTSR_M       (*(volatile uint32_t *)(EXTI_BASE_M + 0x0C)) // Flanco de Bajada
#define EXTI_PR_M         (*(volatile uint32_t *)(EXTI_BASE_M + 0x14)) // Bandera Pendiente

// --- REGISTROS DEL TIMER 4 ---
#define TIM4_CR1_M        (*(volatile uint32_t *)(TIM4_BASE_M + 0x00)) // Control 1
#define TIM4_PSC_M        (*(volatile uint32_t *)(TIM4_BASE_M + 0x28)) // Prescaler
#define TIM4_CNT_M        (*(volatile uint32_t *)(TIM4_BASE_M + 0x24)) // Contador Vivo

// --- REGISTRO MAESTRO CPU (NVIC) ---
#define NVIC_ISER1_M      (*(volatile uint32_t *)(NVIC_BASE_M + 0x04)) // Habilitador maestro
/* USER CODE END PD */

/* Definitions for defaultTask */
osThreadId_t defaultTaskHandle;
const osThreadAttr_t defaultTask_attributes = {
  .name = "defaultTask",
  .stack_size = 128 * 4,
  .priority = (osPriority_t) osPriorityNormal,
};
/* Definitions for myTask02 */
osThreadId_t myTask02Handle;
const osThreadAttr_t myTask02_attributes = {
  .name = "myTask02",
  .stack_size = 128 * 4,
  .priority = (osPriority_t) osPriorityLow,
};
/* Definitions for myTask03 */
osThreadId_t myTask03Handle;
const osThreadAttr_t myTask03_attributes = {
  .name = "myTask03",
  .stack_size = 128 * 4,
  .priority = (osPriority_t) osPriorityLow,
};
/* Definitions for myMutex01 */
osMutexId_t myMutex01Handle;
const osMutexAttr_t myMutex01_attributes = {
  .name = "myMutex01"
};
/* USER CODE BEGIN PV */
volatile uint8_t sistema_pausa = 0;
volatile uint32_t tiempo_ejecucionLD1 = 0;
volatile uint32_t tiempo_ejecucionLD2 = 0;
volatile uint32_t tiempo_ejecucionLD3 = 0;
/* USER CODE END PV */

void SystemClock_Config(void);
static void MX_GPIO_Init(void);
void StartDefaultTask(void *argument);
void StartTask02(void *argument);
void StartTask03(void *argument);

int main(void)
{

  /* MCU Configuration--------------------------------------------------------*/

  /* Reset of all peripherals, Initializes the Flash interface and the Systick. */
  HAL_Init();

  /* Configure the system clock */
  SystemClock_Config();

  /* Initialize all configured peripherals */
  MX_GPIO_Init();
  /* USER CODE BEGIN 2 */
  RCC_AHB1ENR_M |= (1U << 0) | (1U << 2); // HABILITAR PUERTOS A Y C
  RCC_APB1ENR_M |= (1U << 2);   // HABILITACION DE RELOJ TIM4
  RCC_APB2ENR_M |= (1U << 14);  // HABILITAR RELOJ SYSCFG

  // Configuración de modos de pines (PA4, PA5, PA6 y PA7 como salidas lógicas)
  // Pin 4: bits 8-9 | Pin 5: bits 10-11 | Pin 6: bits 12-13 | Pin 7: bits 14-15
  GPIOA_MODER_M &= ~((3U << 8) | (3U << 10) | (3U << 12) | (3U << 14));  // Creamos la mascara
  GPIOA_MODER_M |=  ((1U << 8) | (1U << 10) | (1U << 12) | (1U << 14));  // Asignamos "01" (Salida)

  GPIOC_MODER_M &= ~(3U << 26); // Configuración del boton user en el puerto C como entrada (00)

  // Configuración del puente EXTI13 mapeado al Puerto C
  SYSCFG_EXTICR4_M &= ~(0XFU << 4);     // Limpiar bits de la línea 13 (bits 4 al 7)
  SYSCFG_EXTICR4_M |= (2U << 4);        // 0x2 selecciona Puerto C para la línea EXTI13

  EXTI_IMR_M |= (1U << 13);             // Desenmascarar línea 13
  EXTI_FTSR_M |= (1U << 13);            // Configurar flanco de bajada

  TIM4_PSC_M = 15;                      // Configurar Prescaler (Conteo cada 1 microsegundo)
  TIM4_CR1_M |= (1U << 0);              // Arrancar Timer 4 (CEN = 1)

  NVIC_ISER1_M |= (1U << 8);            // Habilitar la interrupción EXTI15_10 en el NVIC
  /* USER CODE END 2 */

  /* Init scheduler */
  osKernelInitialize();
  /* Create the mutex(es) */
  /* creation of myMutex01 */
  myMutex01Handle = osMutexNew(&myMutex01_attributes);

  /* Create the thread(s) */
  /* creation of defaultTask */
  defaultTaskHandle = osThreadNew(StartDefaultTask, NULL, &defaultTask_attributes);

  /* creation of myTask02 */
  myTask02Handle = osThreadNew(StartTask02, NULL, &myTask02_attributes);

  /* creation of myTask03 */
  myTask03Handle = osThreadNew(StartTask03, NULL, &myTask03_attributes);

  /* Start scheduler */
  osKernelStart();

  /* We should never get here as control is now taken by the scheduler */

  /* Infinite loop */
  while (1)
  {

  }
}

void SystemClock_Config(void)
{
  RCC_OscInitTypeDef RCC_OscInitStruct = {0};
  RCC_ClkInitTypeDef RCC_ClkInitStruct = {0};

  /** Configure the main internal regulator output voltage
  */
  __HAL_RCC_PWR_CLK_ENABLE();
  __HAL_PWR_VOLTAGESCALING_CONFIG(PWR_REGULATOR_VOLTAGE_SCALE3);

  /** Initializes the RCC Oscillators according to the specified parameters
  * in the RCC_OscInitTypeDef structure.
  */
  RCC_OscInitStruct.OscillatorType = RCC_OSCILLATORTYPE_HSI;
  RCC_OscInitStruct.HSIState = RCC_HSI_ON;
  RCC_OscInitStruct.HSICalibrationValue = RCC_HSICALIBRATION_DEFAULT;
  RCC_OscInitStruct.PLL.PLLState = RCC_PLL_ON;
  RCC_OscInitStruct.PLL.PLLSource = RCC_PLLSOURCE_HSI;
  RCC_OscInitStruct.PLL.PLLM = 16;
  RCC_OscInitStruct.PLL.PLLN = 336;
  RCC_OscInitStruct.PLL.PLLP = RCC_PLLP_DIV4;
  RCC_OscInitStruct.PLL.PLLQ = 2;
  RCC_OscInitStruct.PLL.PLLR = 2;
  if (HAL_RCC_OscConfig(&RCC_OscInitStruct) != HAL_OK)
  {
    Error_Handler();
  }

  /** Initializes the CPU, AHB and APB buses clocks
  */
  RCC_ClkInitStruct.ClockType = RCC_CLOCKTYPE_HCLK|RCC_CLOCKTYPE_SYSCLK
                              |RCC_CLOCKTYPE_PCLK1|RCC_CLOCKTYPE_PCLK2;
  RCC_ClkInitStruct.SYSCLKSource = RCC_SYSCLKSOURCE_PLLCLK;
  RCC_ClkInitStruct.AHBCLKDivider = RCC_SYSCLK_DIV1;
  RCC_ClkInitStruct.APB1CLKDivider = RCC_HCLK_DIV2;
  RCC_ClkInitStruct.APB2CLKDivider = RCC_HCLK_DIV1;

  if (HAL_RCC_ClockConfig(&RCC_ClkInitStruct, FLASH_LATENCY_2) != HAL_OK)
  {
    Error_Handler();
  }
}

static void MX_GPIO_Init(void)
{

  /* GPIO Ports Clock Enable */
  __HAL_RCC_GPIOA_CLK_ENABLE();
  __HAL_RCC_GPIOB_CLK_ENABLE();

}

/* USER CODE BEGIN 4 */
// Rutina de Servicio de Interrupción (ISR)
void EXTI15_10_IRQHandler(void){

	GPIOA_ODR_M |= (1U << 5); // Encender pin testigo PA5 inmediatamente al entrar

	if ((EXTI_IMR_M & (1U << 13)) && (EXTI_PR_M & (1U << 13)))
	{
		// Alternar el estado de pausa de las tareas
		if (sistema_pausa == 0) {
			sistema_pausa = 1;
		} else {
			sistema_pausa = 0;
		}

		// OBLIGATORIO BARE-METAL: Limpiar bandera escribiendo un 1 lógico
		EXTI_PR_M |= (1U << 13);
	}

	GPIOA_ODR_M &= ~(1U << 5); // Apagar pin testigo PA5 justo antes de salir
}
/* USER CODE END 4 */

void StartDefaultTask(void *argument)
{
  /* USER CODE BEGIN 5 */
  /* Infinite loop */
  for(;;)
  {
    while (sistema_pausa == 1){
    	osDelay(10);
    }
    if (osMutexAcquire(myMutex01Handle, osWaitForever) == osOK ){
    	TIM4_CNT_M = 0;
    	GPIOA_ODR_M |= (1U << 6); // ENCENDER LED 1 EN PIN PA6

    	osDelay(500);

    	GPIOA_ODR_M &= ~(1U << 6); // APAGAR LED 1 EN PIN PA6
    	tiempo_ejecucionLD1 = TIM4_CNT_M;

    	osMutexRelease(myMutex01Handle);
    }
    osDelay(10);
  }
  /* USER CODE END 5 */
}

void StartTask02(void *argument)
{
  /* USER CODE BEGIN StartTask02 */
  /* Infinite loop */
  for(;;)
  {
    while (sistema_pausa == 1){
    	osDelay(10);
    }
    if (osMutexAcquire(myMutex01Handle, osWaitForever) == osOK)
    {
		// --- INICIO DE SECCIÓN CRÍTICA ---
		TIM4_CNT_M = 0;
		GPIOA_ODR_M |= (1U << 7);   // ENCENDER LED 2 EN PIN PA7

		osDelay(500);

		GPIOA_ODR_M &= ~(1U << 7);  // APAGAR LED 2 EN PIN PA7
		tiempo_ejecucionLD2 = TIM4_CNT_M;
		// --- FIN DE SECCIÓN CRÍTICA ---

		osMutexRelease(myMutex01Handle);
	}

	osDelay(10);
  }
  /* USER CODE END StartTask02 */
}

void StartTask03(void *argument)
{
  /* USER CODE BEGIN StartTask03 */
  /* Infinite loop */
  for(;;)
  {
    while (sistema_pausa == 1){
    	osDelay(10);
    }
    if (osMutexAcquire(myMutex01Handle, osWaitForever) == osOK)
    {
		// --- INICIO DE SECCIÓN CRÍTICA ---
		TIM4_CNT_M = 0;
		GPIOA_ODR_M |= (1U << 4);   // Enceder LED 3 en PA4 (Se queda intacto)

		osDelay(600);

		GPIOA_ODR_M &= ~(1U << 4);  // Apagar LED 3 en PA4
		tiempo_ejecucionLD3 = TIM4_CNT_M;
		// --- FIN DE SECCIÓN CRÍTICA ---

		osMutexRelease(myMutex01Handle);
	}

	osDelay(10);
  }
  /* USER CODE END StartTask03 */
}

void HAL_TIM_PeriodElapsedCallback(TIM_HandleTypeDef *htim)
{
  if (htim->Instance == TIM4) {
    HAL_IncTick();
  }
}

void Error_Handler(void)
{
  __disable_irq();
  while (1)
  {
  }
}
