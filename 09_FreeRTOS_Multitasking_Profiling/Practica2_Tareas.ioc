# file: Practica2_Tareas.ioc
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FREERTOS.Tasks01=defaultTask,24,128,StartDefaultTask,Default,NULL,Dynamic,NULL,NULL;myTask02,8,128,StartTask02,Default,NULL,Dynamic,NULL,NULL;myTask03,8,128,StartTask03,Default,NULL,Dynamic,NULL,NULL;myTask04,8,128,StartTask04,Default,NULL,Dynamic,NULL,NULL;myTask05,8,128,StartTask05,Default,NULL,Dynamic,NULL,NULL
Mcu.Family=STM32F4
Mcu.Name=STM32F446R(C-E)Tx
Mcu.Package=LQFP64
NVIC.PriorityGroup=NVIC_PRIORITYGROUP_4
NVIC.TIM6_DAC_IRQn=true\:15\:0\:false\:false\:true\:false\:false\:true\:true
NVIC.TimeBase=TIM6_DAC_IRQn
NVIC.TimeBaseIP=TIM6
PA13.Mode=Trace_Asynchronous_SW
PA13.Signal=SYS_JTMS-SWDIO
PA14.Mode=Trace_Asynchronous_SW
PA14.Signal=SYS_JTCK-SWCLK
PB3.Mode=Trace_Asynchronous_SW
PB3.Signal=SYS_JTDO-SWO
ProjectManager.HeapSize=0x200
ProjectManager.StackSize=0x400
ProjectManager.TargetToolchain=STM32CubeIDE
RCC.48MHZClocksFreq_Value=84000000
RCC.AHBFreq_Value=84000000
RCC.APB1CLKDivider=RCC_HCLK_DIV2
RCC.APB1Freq_Value=42000000
RCC.APB1TimFreq_Value=84000000
RCC.APB2Freq_Value=84000000
RCC.APB2TimFreq_Value=84000000
RCC.CortexFreq_Value=84000000
RCC.FLatency-AdvancedSettings=FLASH_LATENCY_2
RCC.HCLKFreq_Value=84000000
RCC.HSE_VALUE=8000000
RCC.HSI_VALUE=16000000
RCC.PLLN=336
RCC.PLLP=RCC_PLLP_DIV4
RCC.SYSCLKFreq_VALUE=84000000
RCC.SYSCLKSource=RCC_SYSCLKSOURCE_PLLCLK
RCC.USBFreq_Value=168000000
RCC.VCOOutputFreq_Value=336000000
VP_FREERTOS_VS_CMSIS_V2.Mode=CMSIS_V2
VP_SYS_VS_tim6.Mode=TIM6
board=NUCLEO-F446RE

// file: Core/Src/main.c
/* USER CODE BEGIN Header */
/**
  ******************************************************************************
  * @file           : main.c
  * @brief          : Main program body
  ******************************************************************************
  * @attention
  *
  * Copyright (c) 2026 STMicroelectronics.
  * All rights reserved.
  *
  * This software is licensed under terms that can be found in the LICENSE file
  * in the root directory of this software component.
  * If no LICENSE file comes with this software, it is provided AS-IS.
  *
  ******************************************************************************
  */
/* USER CODE END Header */
#include "main.h"
#include "cmsis_os.h"

/* USER CODE BEGIN PTD */
/* USER CODE BEGIN PTD */
/* --- PERIPHERAL BASE ADDRESSES --- */
#define RCC_BASE_M        0x40023800UL  // Reset and Clock Control
#define GPIOA_BASE_M      0x40020000UL  // Puerto A: Base para pines de osciloscopio
#define TIM4_BASE_M       0x40000800UL  // Timer 4: Telemetría de microsegundos libre

/* --- REGISTROS DE RELOJES (RCC) --- */
#define RCC_AHB1ENR_M     (*(volatile uint32_t *)(RCC_BASE_M + 0x30)) // Reloj GPIOA
#define RCC_APB1ENR_M     (*(volatile uint32_t *)(RCC_BASE_M + 0x40)) // Reloj Periféricos APB1 (TIM4)

/* --- GPIOA PROFILING REGISTERS --- */
#define GPIOA_MODER_M     (*(volatile uint32_t *)(GPIOA_BASE_M + 0x00)) // Configura Entrada/Salida
#define GPIOA_BSRR_M      (*(volatile uint32_t *)(GPIOA_BASE_M + 0x18)) // Control de estado (Set/Reset)

/* --- TIMER 4 REGISTERS (1MHz Timebase) --- */
#define TIM4_CR1_M        (*(volatile uint32_t *)(TIM4_BASE_M + 0x00)) // Control Register 1 (Encendido)
#define TIM4_CNT_M        (*(volatile uint32_t *)(TIM4_BASE_M + 0x24)) // Counter Register (Lectura de tiempo)
#define TIM4_PSC_M        (*(volatile uint32_t *)(TIM4_BASE_M + 0x28)) // Prescaler (Ajuste de MHz)
#define TIM4_ARR_M        (*(volatile uint32_t *)(TIM4_BASE_M + 0x2C)) // Auto-Reload Register

/* Variables globales de telemetría para Live Expressions */
volatile uint32_t time_task1, time_task2, time_task3, time_task4, time_task5;
volatile uint32_t atraso_task5 = 0;
volatile uint32_t tiempo_esperado_task5 = 0;
/* USER CODE END PTD */

/* USER CODE END PTD */

/* Definitions for defaultTask */
osThreadId_t defaultTaskHandle;
const osThreadAttr_t defaultTask_attributes = {
  .name = "defaultTask",
  .stack_size = 128 * 4,
  .priority = (osPriority_t) osPriorityNormal,
};
/* Definitions for myTask02 */
osThreadId_t myTask02Handle;
const osThreadAttr_t myTask02_attributes = {
  .name = "myTask02",
  .stack_size = 128 * 4,
  .priority = (osPriority_t) osPriorityLow,
};
/* Definitions for myTask03 */
osThreadId_t myTask03Handle;
const osThreadAttr_t myTask03_attributes = {
  .name = "myTask03",
  .stack_size = 128 * 4,
  .priority = (osPriority_t) osPriorityLow,
};
/* Definitions for myTask04 */
osThreadId_t myTask04Handle;
const osThreadAttr_t myTask04_attributes = {
  .name = "myTask04",
  .stack_size = 128 * 4,
  .priority = (osPriority_t) osPriorityLow,
};
/* Definitions for myTask05 */
osThreadId_t myTask05Handle;
const osThreadAttr_t myTask05_attributes = {
  .name = "myTask05",
  .stack_size = 128 * 4,
  .priority = (osPriority_t) osPriorityLow,
};

void SystemClock_Config(void);
static void MX_GPIO_Init(void);
void StartDefaultTask(void *argument);
void StartTask02(void *argument);
void StartTask03(void *argument);
void StartTask04(void *argument);
void StartTask05(void *argument);

int main(void)
{

  /* MCU Configuration--------------------------------------------------------*/

  /* Reset of all peripherals, Initializes the Flash interface and the Systick. */
  HAL_Init();

  /* Configure the system clock */
  SystemClock_Config();

  /* Initialize all configured peripherals */
  MX_GPIO_Init();
  /* USER CODE BEGIN 2 */

  RCC_AHB1ENR_M |= (1 << 0);    //Activar puerto A  Bit 0
  RCC_APB1ENR_M |= (1 << 2);    // Activar Timer 4  Bit 2

  GPIOA_MODER_M &= ~((3 << 12) | (3 << 14) | (3 << 16) | (3 << 18) | (3 << 20));
  GPIOA_MODER_M |= ((1 << 12) | (1 << 14) | (1 << 16) | (1 << 18) |  (1 << 20));

  TIM4_PSC_M = 83;
  TIM4_ARR_M = 0XFFFF;
  TIM4_CR1_M |= (1 << 0);

  /* USER CODE END 2 */

  /* Init scheduler */
  osKernelInitialize();

  /* Create the thread(s) */
  /* creation of defaultTask */
  defaultTaskHandle = osThreadNew(StartDefaultTask, NULL, &defaultTask_attributes);

  /* creation of myTask02 */
  myTask02Handle = osThreadNew(StartTask02, NULL, &myTask02_attributes);

  /* creation of myTask03 */
  myTask03Handle = osThreadNew(StartTask03, NULL, &myTask03_attributes);

  /* creation of myTask04 */
  myTask04Handle = osThreadNew(StartTask04, NULL, &myTask04_attributes);

  /* creation of myTask05 */
  myTask05Handle = osThreadNew(StartTask05, NULL, &myTask05_attributes);

  /* Start scheduler */
  osKernelStart();

  /* We should never get here as control is now taken by the scheduler */

  /* Infinite loop */
  while (1)
  {

  }
}

void SystemClock_Config(void)
{
  RCC_OscInitTypeDef RCC_OscInitStruct = {0};
  RCC_ClkInitTypeDef RCC_ClkInitStruct = {0};

  /** Configure the main internal regulator output voltage
  */
  __HAL_RCC_PWR_CLK_ENABLE();
  __HAL_PWR_VOLTAGESCALING_CONFIG(PWR_REGULATOR_VOLTAGE_SCALE3);

  /** Initializes the RCC Oscillators according to the specified parameters
  * in the RCC_OscInitTypeDef structure.
  */
  RCC_OscInitStruct.OscillatorType = RCC_OSCILLATORTYPE_HSI;
  RCC_OscInitStruct.HSIState = RCC_HSI_ON;
  RCC_OscInitStruct.HSICalibrationValue = RCC_HSICALIBRATION_DEFAULT;
  RCC_OscInitStruct.PLL.PLLState = RCC_PLL_ON;
  RCC_OscInitStruct.PLL.PLLSource = RCC_PLLSOURCE_HSI;
  RCC_OscInitStruct.PLL.PLLM = 16;
  RCC_OscInitStruct.PLL.PLLN = 336;
  RCC_OscInitStruct.PLL.PLLP = RCC_PLLP_DIV4;
  RCC_OscInitStruct.PLL.PLLQ = 2;
  RCC_OscInitStruct.PLL.PLLR = 2;
  if (HAL_RCC_OscConfig(&RCC_OscInitStruct) != HAL_OK)
  {
    Error_Handler();
  }

  /** Initializes the CPU, AHB and APB buses clocks
  */
  RCC_ClkInitStruct.ClockType = RCC_CLOCKTYPE_HCLK|RCC_CLOCKTYPE_SYSCLK
                              |RCC_CLOCKTYPE_PCLK1|RCC_CLOCKTYPE_PCLK2;
  RCC_ClkInitStruct.SYSCLKSource = RCC_SYSCLKSOURCE_PLLCLK;
  RCC_ClkInitStruct.AHBCLKDivider = RCC_SYSCLK_DIV1;
  RCC_ClkInitStruct.APB1CLKDivider = RCC_HCLK_DIV2;
  RCC_ClkInitStruct.APB2CLKDivider = RCC_HCLK_DIV1;

  if (HAL_RCC_ClockConfig(&RCC_ClkInitStruct, FLASH_LATENCY_2) != HAL_OK)
  {
    Error_Handler();
  }
}

static void MX_GPIO_Init(void)
{

  /* GPIO Ports Clock Enable */
  __HAL_RCC_GPIOA_CLK_ENABLE();
  __HAL_RCC_GPIOB_CLK_ENABLE();

}

/* USER CODE BEGIN 4 */

void QuemarCiclos(uint32_t iteraciones) {
	volatile uint32_t i;
	for (i = 0; i < iteraciones; i++);
}

/* USER CODE END 4 */

void StartDefaultTask(void *argument)
{
  for(;;)
  {
    osDelay(1);
  }
}

void StartTask02(void *argument)
{
  for(;;)
  {
    osDelay(1);
  }
}

void StartTask03(void *argument)
{
  for(;;)
  {
    osDelay(1);
  }
}

void StartTask04(void *argument)
{
  for(;;)
  {
    osDelay(1);
  }
}

void StartTask05(void *argument)
{
  for(;;)
  {
    osDelay(1);
  }
}

void HAL_TIM_PeriodElapsedCallback(TIM_HandleTypeDef *htim)
{
  if (htim->Instance == TIM6) {
    HAL_IncTick();
  }
}

void Error_Handler(void)
{
  __disable_irq();
  while (1)
  {
  }
}
